// SPDX-License-Identifier: GPL-2.0-only
/*
 * Copyright (C) 2023 Synopsys, Inc. (www.synopsys.com)
 */
/dts-v1/;

/include/ "skeleton_hs.dtsi"
/include/ "skeleton_haps.dtsi"

/ {
	model = "snps,zebu_hs5x";
	compatible = "snps,zebu_hs";

	memory {
		/* CONFIG_LINUX_RAM_BASE needs to match low mem start */
		reg = <0x0 0x00000000 0x0 0x60000000>;	/* 1.5 GB low mem */
	};

	chosen {
		bootargs = "earlycon=uart8250,mmio32,0xf0000000,115200n8 console=ttyS0,115200n8 debug print-fatal-signals=1";
	};
};
